/*
 Adapted from the Adafruit and Xark's PDQ graphicstest sketch.

 See end of file for original header text and MIT license info.
 
 This sketch uses the TomThumb4x6 bitmap font only.

 Make sure all the display driver and pin connections are correct by
 editing the Display/Presets/ExampleBoard.h file in the NICE_GFX library folder.

 #########################################################################
 ###### DON'T FORGET TO UPDATE THE Display/Presets/ExampleBoard.h FILE IN THE LIBRARY ######
 #########################################################################
 */

#include "SPI.h"
#include "NICE_GFX.h"
#include <Display/Presets/ExampleBoard.h>

// Use hardware SPI
ExampleDisplay gfx;

unsigned long total = 0;
unsigned long tn = 0;
void setup() {
  Serial.begin(115200);
  while (!Serial);
  Serial.println(""); Serial.println("");
  Serial.println("NICE_GFX library test");
 
  gfx.begin();
  gfx.setFont(nice_gfx::fonts::TomThumb4x6);
}

void loop(void)
{

	Serial.println(F("Benchmark                Time (microseconds)"));

	uint32_t usecHaD = testHaD();
	Serial.print(F("HaD pushColor            "));
	Serial.println(usecHaD);
	delay(100);

	uint32_t usecFillScreen = testFillScreen();
	Serial.print(F("Screen fill              "));
	Serial.println(usecFillScreen);
	delay(100);

	uint32_t usecText = testText();
	Serial.print(F("Text                     "));
	Serial.println(usecText);
	delay(100);

	uint32_t usecPixels = testPixels();
	Serial.print(F("Pixels                   "));
	Serial.println(usecPixels);
	delay(100);

	uint32_t usecLines = testLines(GFX_BLUE);
	Serial.print(F("Lines                    "));
	Serial.println(usecLines);
	delay(100);

	uint32_t usecFastLines = testFastLines(GFX_RED, GFX_BLUE);
	Serial.print(F("Horiz/Vert Lines         "));
	Serial.println(usecFastLines);
	delay(100);

	uint32_t usecRects = testRects(GFX_GREEN);
	Serial.print(F("Rectangles (outline)     "));
	Serial.println(usecRects);
	delay(100);

	uint32_t usecFilledRects = testFilledRects(GFX_YELLOW, GFX_MAGENTA);
	Serial.print(F("Rectangles (filled)      "));
	Serial.println(usecFilledRects);
	delay(100);

	uint32_t usecFilledCircles = testFilledCircles(10, GFX_MAGENTA);
	Serial.print(F("Circles (filled)         "));
	Serial.println(usecFilledCircles);
	delay(100);

	uint32_t usecCircles = testCircles(10, GFX_WHITE);
	Serial.print(F("Circles (outline)        "));
	Serial.println(usecCircles);
	delay(100);

	uint32_t usecTriangles = testTriangles();
	Serial.print(F("Triangles (outline)      "));
	Serial.println(usecTriangles);
	delay(100);

	uint32_t usecFilledTrangles = testFilledTriangles();
	Serial.print(F("Triangles (filled)       "));
	Serial.println(usecFilledTrangles);
	delay(100);

	uint32_t usecRoundRects = testRoundRects();
	Serial.print(F("Rounded rects (outline)  "));
	Serial.println(usecRoundRects);
	delay(100);

	uint32_t usedFilledRoundRects = testFilledRoundRects();
	Serial.print(F("Rounded rects (filled)   "));
	Serial.println(usedFilledRoundRects);
	delay(100);

	Serial.println(F("Done!"));

	uint16_t c = 4;
	int8_t d = 1;
	for (int32_t i = 0; i < gfx.height(); i++)
	{
		gfx.drawFastHLine(0, i, gfx.width(), c);
		c += d;
		if (c <= 4 || c >= 11)
			d = -d;
	}
	
	gfx.setCursor(0, 0);
	gfx.setTextColor(GFX_MAGENTA);
	gfx.setTextSize(2);

	gfx.println(F("   NICE_GFX test"));

	gfx.setTextSize(1);
	gfx.setTextColor(GFX_WHITE);
	gfx.println(F(""));
	gfx.setTextSize(1);
	gfx.println(F(""));
	gfx.setTextColor(gfx.color565(0x80, 0x80, 0x80));

	gfx.println(F(""));


	gfx.setTextColor(GFX_GREEN);
	gfx.println(F(" Benchmark               microseconds"));
	gfx.println(F(""));
	gfx.setTextColor(GFX_YELLOW);

	gfx.setTextColor(GFX_CYAN); gfx.setTextSize(1);
	gfx.print(F("HaD pushColor      "));
	gfx.setTextColor(GFX_YELLOW); gfx.setTextSize(2);
	printnice(usecHaD);

	gfx.setTextColor(GFX_CYAN); gfx.setTextSize(1);
	gfx.print(F("Screen fill        "));
	gfx.setTextColor(GFX_YELLOW); gfx.setTextSize(2);
	printnice(usecFillScreen);

	gfx.setTextColor(GFX_CYAN); gfx.setTextSize(1);
	gfx.print(F("Text               "));
	gfx.setTextColor(GFX_YELLOW); gfx.setTextSize(2);
	printnice(usecText);

	gfx.setTextColor(GFX_CYAN); gfx.setTextSize(1);
	gfx.print(F("Pixels             "));
	gfx.setTextColor(GFX_YELLOW); gfx.setTextSize(2);
	printnice(usecPixels);

	gfx.setTextColor(GFX_CYAN); gfx.setTextSize(1);
	gfx.print(F("Lines              "));
	gfx.setTextColor(GFX_YELLOW); gfx.setTextSize(2);
	printnice(usecLines);

	gfx.setTextColor(GFX_CYAN); gfx.setTextSize(1);
	gfx.print(F("Horiz/Vert Lines   "));
	gfx.setTextColor(GFX_YELLOW); gfx.setTextSize(2);
	printnice(usecFastLines);

	gfx.setTextColor(GFX_CYAN); gfx.setTextSize(1);
	gfx.print(F("Rectangles         "));
	gfx.setTextColor(GFX_YELLOW); gfx.setTextSize(2);
	printnice(usecRects);

	gfx.setTextColor(GFX_CYAN); gfx.setTextSize(1);
	gfx.print(F("Rectangles-filled  "));
	gfx.setTextColor(GFX_YELLOW); gfx.setTextSize(2);
	printnice(usecFilledRects);

	gfx.setTextColor(GFX_CYAN); gfx.setTextSize(1);
	gfx.print(F("Circles            "));
	gfx.setTextColor(GFX_YELLOW); gfx.setTextSize(2);
	printnice(usecCircles);

	gfx.setTextColor(GFX_CYAN); gfx.setTextSize(1);
	gfx.print(F("Circles-filled     "));
	gfx.setTextColor(GFX_YELLOW); gfx.setTextSize(2);
	printnice(usecFilledCircles);

	gfx.setTextColor(GFX_CYAN); gfx.setTextSize(1);
	gfx.print(F("Triangles          "));
	gfx.setTextColor(GFX_YELLOW); gfx.setTextSize(2);
	printnice(usecTriangles);

	gfx.setTextColor(GFX_CYAN); gfx.setTextSize(1);
	gfx.print(F("Triangles-filled   "));
	gfx.setTextColor(GFX_YELLOW); gfx.setTextSize(2);
	printnice(usecFilledTrangles);

	gfx.setTextColor(GFX_CYAN); gfx.setTextSize(1);
	gfx.print(F("Rounded rects      "));
	gfx.setTextColor(GFX_YELLOW); gfx.setTextSize(2);
	printnice(usecRoundRects);

	gfx.setTextColor(GFX_CYAN); gfx.setTextSize(1);
	gfx.print(F("Rounded rects-fill "));
	gfx.setTextColor(GFX_YELLOW); gfx.setTextSize(2);
	printnice(usedFilledRoundRects);

	gfx.setTextSize(1);
	gfx.println(F(""));
	gfx.setTextColor(GFX_GREEN); gfx.setTextSize(2);
	gfx.print(F("Benchmark Complete!"));

	delay(60 * 1000L);
}

void printnice(int32_t v)
{
	char	str[32] = { 0 };
	sprintf(str, "%d", v);
	for (char *p = (str+strlen(str))-3; p > str; p -= 3)
	{
		memmove(p+1, p, strlen(p)+1);
		*p = ',';
		
	}
	while (strlen(str) < 10)
	{
		memmove(str+1, str, strlen(str)+1);
		*str = ' ';
	}
	gfx.println(str);
}

static inline uint32_t micros_start() __attribute__ ((always_inline));
static inline uint32_t micros_start()
{
	uint8_t oms = millis();
	while ((uint8_t)millis() == oms)
		;
	return micros();
}

uint32_t testHaD()
{
	// pseudo-code for cheesy RLE
	// start with color1
	// while more input data remaining
	// 	count =  0nnnnnnn = 1 byte or 1nnnnnnn nnnnnnnn 2 bytes (0 - 32767)
	// 	repeat color count times
	// 	toggle color1/color2
	static const uint8_t HaD_240x320[] PROGMEM =
	{
		0xb9, 0x50, 0x0e, 0x80, 0x93, 0x0e, 0x41, 0x11, 0x80, 0x8d, 0x11, 0x42, 0x12, 0x80, 0x89, 0x12, 
		0x45, 0x12, 0x80, 0x85, 0x12, 0x48, 0x12, 0x80, 0x83, 0x12, 0x4a, 0x13, 0x7f, 0x13, 0x4c, 0x13, 
		0x7d, 0x13, 0x4e, 0x13, 0x7b, 0x13, 0x50, 0x13, 0x79, 0x13, 0x52, 0x13, 0x77, 0x13, 0x54, 0x13, 
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		0x45, 0x04, 0x80, 0x9d, 0x04, 0xb9, 0x56, 
	};
	
	gfx.fillScreen(GFX_BLACK);

	uint32_t start = micros_start();

	for (int i = 0; i < 0x10; i++)
	{
		gfx.setAddrWindow(0, 0, 240, 320);

		uint16_t cnt = 0;
		uint16_t color = gfx.color565((i << 4) | i, (i << 4) | i, (i << 4) | i);
		uint16_t curcolor = 0;

		const uint8_t *cmp = &HaD_240x320[0];

		gfx.startWrite();
		while (cmp < &HaD_240x320[sizeof(HaD_240x320)])
		{
			cnt = pgm_read_byte(cmp++);
			if (cnt & 0x80) cnt = ((cnt & 0x7f) << 8) | pgm_read_byte(cmp++);
			gfx.pushBlock(curcolor, cnt);	// PDQ_GFX has count
			curcolor ^= color;
		}
		gfx.endWrite();
	}

	uint32_t t = micros() - start;

	gfx.setTextColor(GFX_YELLOW);
	gfx.setTextSize(2);
	gfx.setCursor(8, 285);
	gfx.print(F("http://hackaday.io/"));
	gfx.setCursor(96, 302);
	gfx.print(F("Xark"));

	delay(3 * 1000L);
	
	return t;
}

uint32_t testFillScreen()
{
	uint32_t start = micros_start();
    // Shortened this tedious test!
		gfx.fillScreen(GFX_WHITE);
		gfx.fillScreen(GFX_RED);
		gfx.fillScreen(GFX_GREEN);
		gfx.fillScreen(GFX_BLUE);
		gfx.fillScreen(GFX_BLACK);

	return (micros() - start)/5;
}

uint32_t testText()
{
	gfx.fillScreen(GFX_BLACK);
	uint32_t start = micros_start();
	gfx.setCursor(0, 0);
	gfx.setTextColor(GFX_WHITE,GFX_BLACK);	gfx.setTextSize(1);
	gfx.println(F("Hello World!"));
	gfx.setTextSize(2);
	gfx.setTextColor(gfx.color565(0xff, 0x00, 0x00));
	gfx.print(F("RED "));
	gfx.setTextColor(gfx.color565(0x00, 0xff, 0x00));
	gfx.print(F("GREEN "));
	gfx.setTextColor(gfx.color565(0x00, 0x00, 0xff));
	gfx.println(F("BLUE"));
	gfx.setTextColor(GFX_YELLOW); gfx.setTextSize(2);
	gfx.println(1234.56);
	gfx.setTextColor(GFX_RED);		gfx.setTextSize(3);
	gfx.println(0xDEADBEEF, HEX);
	gfx.println();
	gfx.setTextColor(GFX_GREEN);
	gfx.setTextSize(5);
	gfx.println(F("Groop"));
	gfx.setTextSize(2);
	gfx.println(F("I implore thee,"));
  gfx.setTextColor(GFX_GREEN);
	gfx.setTextSize(1);
	gfx.println(F("my foonting turlingdromes."));
	gfx.println(F("And hooptiously drangle me"));
	gfx.println(F("with crinkly bindlewurdles,"));
	gfx.println(F("Or I will rend thee"));
	gfx.println(F("in the gobberwarts"));
	gfx.println(F("with my blurglecruncheon,"));
	gfx.println(F("see if I don't!"));
	gfx.println(F(""));
	gfx.println(F(""));
	gfx.setTextColor(GFX_MAGENTA);
	gfx.setTextSize(6);
	gfx.println(F("Woot!"));
	uint32_t t = micros() - start;
	delay(1000);
	return t;
}

uint32_t testPixels()
{
	int32_t	w = gfx.width();
	int32_t	h = gfx.height();

	uint32_t start = micros_start();
	gfx.startWrite();
	for (uint16_t y = 0; y < h; y++)
	{
		for (uint16_t x = 0; x < w; x++)
		{
			gfx.drawPixel(x, y, gfx.color565(x<<3, y<<3, x*y));
		}
	}
	gfx.endWrite();
	return micros() - start;
}


uint32_t testLines(uint16_t color)
{
	uint32_t start, t;
	int32_t	x1, y1, x2, y2;
	int32_t	w = gfx.width();
	int32_t	h = gfx.height();

	gfx.fillScreen(GFX_BLACK);

	x1 = y1 = 0;
	y2 = h - 1;

	start = micros_start();

	for (x2 = 0; x2 < w; x2 += 6)
	{
		gfx.drawLine(x1, y1, x2, y2, color);
	}

	x2 = w - 1;

	for (y2 = 0; y2 < h; y2 += 6)
	{
		gfx.drawLine(x1, y1, x2, y2, color);
	}

	t = micros() - start; // fillScreen doesn't count against timing

	gfx.fillScreen(GFX_BLACK);

	x1 = w - 1;
	y1 = 0;
	y2 = h - 1;

	start = micros_start();

	for (x2 = 0; x2 < w; x2 += 6)
	{
		gfx.drawLine(x1, y1, x2, y2, color);
	}

	x2 = 0;
	for (y2 = 0; y2 < h; y2 += 6)
	{
		gfx.drawLine(x1, y1, x2, y2, color);
	}

	t += micros() - start;

	gfx.fillScreen(GFX_BLACK);

	x1 = 0;
	y1 = h - 1;
	y2 = 0;

	start = micros_start();

	for (x2 = 0; x2 < w; x2 += 6)
	{
		gfx.drawLine(x1, y1, x2, y2, color);
	}
	x2 = w - 1;
	for (y2 = 0; y2 < h; y2 += 6)
	{
		gfx.drawLine(x1, y1, x2, y2, color);
	}
	t += micros() - start;

	gfx.fillScreen(GFX_BLACK);

	x1 = w - 1;
	y1 = h - 1;
	y2 = 0;

	start = micros_start();

	for (x2 = 0; x2 < w; x2 += 6)
	{
		gfx.drawLine(x1, y1, x2, y2, color);
	}

	x2 = 0;
	for (y2 = 0; y2 < h; y2 += 6)
	{
		gfx.drawLine(x1, y1, x2, y2, color);
	}

	t += micros() - start;

	return t;
}

uint32_t testFastLines(uint16_t color1, uint16_t color2)
{
	uint32_t start;
	int32_t x, y;
	int32_t w = gfx.width();
	int32_t h = gfx.height();

	gfx.fillScreen(GFX_BLACK);

	start = micros_start();

	for (y = 0; y < h; y += 5)
		gfx.drawFastHLine(0, y, w, color1);
	for (x = 0; x < w; x += 5)
		gfx.drawFastVLine(x, 0, h, color2);

	return micros() - start;
}

uint32_t testRects(uint16_t color)
{
	uint32_t start;
	int32_t n, i, i2;
	int32_t cx = gfx.width() / 2;
	int32_t cy = gfx.height() / 2;

	gfx.fillScreen(GFX_BLACK);
	n = min(gfx.width(), gfx.height());
	start = micros_start();
	for (i = 2; i < n; i += 6)
	{
		i2 = i / 2;
		gfx.drawRect(cx-i2, cy-i2, i, i, color);
	}

	return micros() - start;
}

uint32_t testFilledRects(uint16_t color1, uint16_t color2)
{
	uint32_t start, t = 0;
	int32_t n, i, i2;
	int32_t cx = gfx.width() / 2 - 1;
	int32_t cy = gfx.height() / 2 - 1;

	gfx.fillScreen(GFX_BLACK);
	n = min(gfx.width(), gfx.height());
	for (i = n; i > 0; i -= 6)
	{
		i2 = i / 2;

		start = micros_start();

		gfx.fillRect(cx-i2, cy-i2, i, i, color1);

		t += micros() - start;

		// Outlines are not included in timing results
		gfx.drawRect(cx-i2, cy-i2, i, i, color2);
	}

	return t;
}

uint32_t testFilledCircles(uint8_t radius, uint16_t color)
{
	uint32_t start;
	int32_t x, y, w = gfx.width(), h = gfx.height(), r2 = radius * 2;

	gfx.fillScreen(GFX_BLACK);

	start = micros_start();

	for (x = radius; x < w; x += r2)
	{
		for (y = radius; y < h; y += r2)
		{
			gfx.fillCircle(x, y, radius, color);
		}
	}

	return micros() - start;
}

uint32_t testCircles(uint8_t radius, uint16_t color)
{
	uint32_t start;
	int32_t x, y, r2 = radius * 2;
	int32_t w = gfx.width() + radius;
	int32_t h = gfx.height() + radius;

	// Screen is not cleared for this one -- this is
	// intentional and does not affect the reported time.
	start = micros_start();

	for (x = 0; x < w; x += r2)
	{
		for (y = 0; y < h; y += r2)
		{
			gfx.drawCircle(x, y, radius, color);
		}
	}

	return micros() - start;
}

uint32_t testTriangles()
{
	uint32_t start;
	int32_t n, i;
	int32_t cx = gfx.width()/ 2 - 1;
	int32_t cy = gfx.height() / 2 - 1;

	gfx.fillScreen(GFX_BLACK);
	n = min(cx, cy);

	start = micros_start();

	for (i = 0; i < n; i += 5)
	{
		gfx.drawTriangle(
			cx		, cy - i, // peak
			cx - i, cy + i, // bottom left
			cx + i, cy + i, // bottom right
			gfx.color565(0, 0, i));
	}

	return micros() - start;
}

uint32_t testFilledTriangles()
{
	uint32_t start, t = 0;
	int32_t i;
	int32_t cx = gfx.width() / 2 - 1;
	int32_t cy = gfx.height() / 2 - 1;

	gfx.fillScreen(GFX_BLACK);

	start = micros_start();

	for (i = min(cx,cy); i > 10; i -= 5) {
		start = micros_start();
		gfx.fillTriangle(cx, cy - i, cx - i, cy + i, cx + i, cy + i,
			gfx.color565(0, i, i));
		t += micros() - start;
		gfx.drawTriangle(cx, cy - i, cx - i, cy + i, cx + i, cy + i,
			gfx.color565(i, i, 0));
	}

	return t;
}

uint32_t testRoundRects()
 {
	uint32_t start;
	int32_t w, i, i2;
	int32_t cx = gfx.width() / 2 - 1;
	int32_t cy = gfx.height() / 2 - 1;

	gfx.fillScreen(GFX_BLACK);
	
	w = min(gfx.width(), gfx.height());
	
	start = micros_start();

	for (i = 0; i < w; i += 6)
	{
		i2 = i / 2;
		gfx.drawRoundRect(cx-i2, cy-i2, i, i, i/8, gfx.color565(i, 0, 0));
	}

	return micros() - start;
}

uint32_t testFilledRoundRects()
{
	uint32_t start;
	int32_t i, i2;
	int32_t cx = gfx.width() / 2 - 1;
	int32_t cy = gfx.height() / 2 - 1;

	gfx.fillScreen(GFX_BLACK);

	start = micros_start();

	for (i = min(gfx.width(), gfx.height()); i > 20; i -= 6)
	{
		i2 = i / 2;
		gfx.fillRoundRect(cx-i2, cy-i2, i, i, i/8, gfx.color565(0, i, 0));
	}

	return micros() - start;
}

/***************************************************
  Original sketch text:

  This is an example sketch for the Adafruit 2.2" SPI display.
  This library works with the Adafruit 2.2" TFT Breakout w/SD card
  ----> http://www.adafruit.com/products/1480
 
  Check out the links above for our tutorials and wiring diagrams
  These displays use SPI to communicate, 4 or 5 pins are required to
  interface (RST is optional)
  Adafruit invests time and resources providing this open source code,
  please support Adafruit and open-source hardware by purchasing
  products from Adafruit!

  Written by Limor Fried/Ladyada for Adafruit Industries.
  MIT license, all text above must be included in any redistribution
 ****************************************************/
 
