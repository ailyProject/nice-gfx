// Generated by @nice-gfx/html-ui. Replace this file to update the UI.
#pragma once
#ifndef NICE_GFX_UI_HEADER
#define NICE_GFX_UI_HEADER <UI/View.h>
#endif
#ifndef NICE_GFX_FONTS_HEADER
#define NICE_GFX_FONTS_HEADER <Fonts/Builtin.h>
#endif
#include NICE_GFX_UI_HEADER
#if !defined(NICE_GFX_UI_DYNAMIC_IMAGE_VERSION) || NICE_GFX_UI_DYNAMIC_IMAGE_VERSION < 1
#error "Dynamic image components require the updated NICE_GFX runtime; export the complete Arduino project."
#endif
#if !defined(NICE_GFX_ANTIALIASING_VERSION) || NICE_GFX_ANTIALIASING_VERSION < 1
#error "Font and icon antialiasing requires the updated NICE_GFX runtime; export the complete Arduino project."
#endif
#include <cstring>
#include NICE_GFX_FONTS_HEADER

namespace ui_config {
using nice_gfx::htmlui::Id;
using nice_gfx::htmlui::View;
using nice_gfx::htmlui::EventHandler;

namespace detail {
constexpr Id hashId(const char *text, Id hash) {
  return *text ? hashId(text + 1, (hash ^ static_cast<unsigned char>(*text)) * 16777619u) : hash;
}
}
// UTF-8 byte FNV-1a, identical to compiler elementId(). Null maps to no element.
constexpr Id id(const char *text) { return text ? detail::hashId(text, 2166136261u) : 0u; }
constexpr bool edgeBack = false;
constexpr bool swipeHome = false;

// Immutable compiled media; all imported project assets are available for runtime switching.
inline const nice_gfx::htmlui::MediaDesc *media(const char *assetId) {
  using namespace nice_gfx::htmlui;
  if (!assetId) return nullptr;
  static const uint8_t media_0_pixels[] PROGMEM = {
    0xf8,0x00,0x00,0x1f,0x07,0xe0,0xff,0xff,
  };
  static const MediaDesc media_0 = {media_0_pixels, 2, 2, 1, 1, 2};
  static const uint8_t media_1_pixels[] PROGMEM = {
    0xff,0xe0,0xff,0xe0,0x07,0xff,0x07,0xff,
  };
  static const MediaDesc media_1 = {media_1_pixels, 2, 2, 1, 1, 2};
  if (std::strcmp(assetId, "demo-checker") == 0) return &media_0;
  if (std::strcmp(assetId, "demo-stripes") == 0) return &media_1;
  return nullptr;
}

inline nice_gfx::Status setMedia(View &view, Id element, const char *assetId) {
  const nice_gfx::htmlui::MediaDesc *resource = media(assetId);
  return resource ? view.setMediaResource(element, *resource) : nice_gfx::Status::InvalidArgument;
}

// C++11 inline-function local statics are one shared instance across all TUs.
inline const nice_gfx::htmlui::ProjectDesc &project() {
  using namespace nice_gfx::htmlui;
  static_assert(ResourceVersion == 15, "UI compiler/runtime resource mismatch");
  static const NodeDesc page_0_nodes[] = {
    { NoParent, 2343899447u, Kind::Container, {0, 0, 480, 480}, {63423, 4358, 52924, 52924, 8989, 65535, 63423, 63423, 0, 0, 1, 0, 0, 0, 0, 0, 6, 20, 20, 10, nullptr, nullptr}, "", 0, 0, 100, 1, 0, "", RouteAction::None, 0u, {}, {}, nullptr, nullptr, nullptr, nullptr, nullptr, nullptr, nullptr },
    { 0, 3536372366u, Kind::Container, {0, 0, 480, 480}, {0, 4358, 52924, 52924, 8989, 65535, 0, 0, 0, 0, 1, 0, 24, 24, 24, 24, 6, 20, 20, 10, nullptr, nullptr}, "", 0, 0, 100, 1, 6160, "", RouteAction::None, 0u, {}, {}, nullptr, nullptr, nullptr, nullptr, nullptr, nullptr, nullptr },
    { 1, 2556802313u, Kind::Text, {24, 24, 432, 24}, {0, 4358, 52924, 52924, 8989, 65535, 0, 0, 0, 0, 1, 0, 0, 0, 0, 0, 6, 20, 20, 10, &nice_gfx::fonts::UnifontCN16, nullptr}, "Device image updates", 0, 0, 100, 1, 6160, "", RouteAction::None, 0u, {}, {}, nullptr, nullptr, nullptr, nullptr, nullptr, nullptr, nullptr },
    { 1, 2166822627u, Kind::Media, {24, 60, 432, 240}, {0, 4358, 52924, 52924, 8989, 65535, 0, 0, 0, 0, 1, 0, 0, 0, 0, 0, 6, 20, 20, 10, nullptr, nullptr}, "", 0, 0, 100, 1, 6160, "", RouteAction::None, 0u, {}, {}, nullptr, media("demo-checker"), nullptr, nullptr, nullptr, nullptr, nullptr },
    { 1, 3125508079u, Kind::Text, {24, 312, 432, 24}, {0, 4358, 52924, 52924, 8989, 65535, 0, 0, 0, 0, 1, 0, 0, 0, 0, 0, 6, 20, 20, 10, &nice_gfx::fonts::UnifontCN16, nullptr}, "Authored fallback", 0, 0, 100, 1, 6160, "", RouteAction::None, 0u, {}, {}, nullptr, nullptr, nullptr, nullptr, nullptr, nullptr, nullptr },
    { 1, 2260011352u, Kind::Container, {24, 348, 432, 44}, {0, 4358, 52924, 52924, 8989, 65535, 0, 0, 0, 0, 1, 0, 0, 0, 0, 0, 6, 20, 20, 10, nullptr, nullptr}, "", 0, 0, 100, 1, 6160, "", RouteAction::None, 0u, {}, {}, nullptr, nullptr, nullptr, nullptr, nullptr, nullptr, nullptr },
    { 5, 1330812590u, Kind::Button, {24, 348, 216, 44}, {8989, 65535, 52924, 52924, 8989, 65535, 6779, 38167, 0, 8, 1, 1, 8, 12, 8, 12, 6, 20, 20, 10, &nice_gfx::fonts::UnifontCN16, nullptr}, "Generate", 0, 0, 100, 1, 0, "", RouteAction::None, 0u, {}, {}, nullptr, nullptr, nullptr, nullptr, nullptr, nullptr, nullptr },
    { 5, 702513141u, Kind::Button, {248, 348, 216, 44}, {8989, 65535, 52924, 52924, 8989, 65535, 6779, 38167, 0, 8, 1, 1, 8, 12, 8, 12, 6, 20, 20, 10, &nice_gfx::fonts::UnifontCN16, nullptr}, "Resource", 0, 0, 100, 1, 0, "", RouteAction::None, 0u, {}, {}, nullptr, nullptr, nullptr, nullptr, nullptr, nullptr, nullptr },
    { 1, 2209678495u, Kind::Container, {24, 404, 432, 44}, {0, 4358, 52924, 52924, 8989, 65535, 0, 0, 0, 0, 1, 0, 0, 0, 0, 0, 6, 20, 20, 10, nullptr, nullptr}, "", 0, 0, 100, 1, 6160, "", RouteAction::None, 0u, {}, {}, nullptr, nullptr, nullptr, nullptr, nullptr, nullptr, nullptr },
    { 8, 1550717474u, Kind::Button, {24, 404, 216, 44}, {8989, 65535, 52924, 52924, 8989, 65535, 6779, 38167, 0, 8, 1, 1, 8, 12, 8, 12, 6, 20, 20, 10, &nice_gfx::fonts::UnifontCN16, nullptr}, "Clear", 0, 0, 100, 1, 0, "", RouteAction::None, 0u, {}, {}, nullptr, nullptr, nullptr, nullptr, nullptr, nullptr, nullptr },
    { 8, 1695364032u, Kind::Button, {248, 404, 216, 44}, {8989, 65535, 52924, 52924, 8989, 65535, 6779, 38167, 0, 8, 1, 1, 8, 12, 8, 12, 6, 20, 20, 10, &nice_gfx::fonts::UnifontCN16, nullptr}, "Reset", 0, 0, 100, 1, 0, "", RouteAction::None, 0u, {}, {}, nullptr, nullptr, nullptr, nullptr, nullptr, nullptr, nullptr },
  };
  static const PageDesc pages[] = {
    { "/", page_0_nodes, 11, 480, 480, 63423, nullptr, nullptr },
  };
  static const ProjectDesc resource = {pages, 1, 0, ResourceVersion, {TransitionEffect::None, AnimationEasing::EaseOut, 280}};
  return resource;
}

inline nice_gfx::Status load(View &view) {
  const nice_gfx::Status status = view.mount(project());
  if (status == nice_gfx::Status::Ok) { view.setEdgeBackEnabled(edgeBack); view.setSwipeHomeEnabled(swipeHome); }
  if (status == nice_gfx::Status::Ok && !view.configureNavigation(nullptr)) return nice_gfx::Status::InvalidArgument;
  return status;
}

// Bind each action once per View. Registration is additive, including after load().
// A null callback returns false without adding listeners; callbacks/context stay user-owned.
// A false result does not roll back any earlier successful registration.
inline bool bind_startDynamic(View &view, EventHandler callback, void *context = nullptr) {
  if (!callback) return false;
  bool ok = true;
  ok = view.on(1330812590u, nice_gfx::htmlui::EventType::Click, callback, context) && ok;
  return ok;
}
inline bool bind_switchResource(View &view, EventHandler callback, void *context = nullptr) {
  if (!callback) return false;
  bool ok = true;
  ok = view.on(702513141u, nice_gfx::htmlui::EventType::Click, callback, context) && ok;
  return ok;
}
inline bool bind_clearPhoto(View &view, EventHandler callback, void *context = nullptr) {
  if (!callback) return false;
  bool ok = true;
  ok = view.on(1550717474u, nice_gfx::htmlui::EventType::Click, callback, context) && ok;
  return ok;
}
inline bool bind_resetPhoto(View &view, EventHandler callback, void *context = nullptr) {
  if (!callback) return false;
  bool ok = true;
  ok = view.on(1695364032u, nice_gfx::htmlui::EventType::Click, callback, context) && ok;
  return ok;
}

} // namespace ui_config
