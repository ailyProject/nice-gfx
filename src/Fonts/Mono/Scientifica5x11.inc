// Generated by Tools/generate_editor_fonts.mjs; ASCII subset, original glyph pixels.
// Copyright (c) 2020/2021 Akshay Oppiliappan; Copyright (c) 2015 romeovs
// Source: https://github.com/oppiliappan/scientifica/releases/download/v2.3/scientifica.tar (scientifica/bdf/scientifica-11.bdf)
// BDF SHA-256: d298f1fe8ce2234a1ecaeff7ab7c9db7cf47b74b658f4e8d614a7f4e8e702049
// License: OFL-1.1; Fonts/licenses/Scientifica-OFL-1.1.txt
static const uint8_t Scientifica5x11Bitmap[] PROGMEM = {
  0x00, 0x00, 0x00, 0x00, 0x00, 0x00, 0x00, 0x00, 0x00, 0x00, 0x00, 0x00, 0x00, 0x20, 0x20, 0x20,
  0x20, 0x20, 0x00, 0x20, 0x00, 0x00, 0x00, 0x00, 0x50, 0x50, 0x50, 0x00, 0x00, 0x00, 0x00, 0x00,
  0x00, 0x00, 0x00, 0x00, 0x00, 0x50, 0xf8, 0x50, 0xf8, 0x50, 0x00, 0x00, 0x00, 0x20, 0x20, 0x70,
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  0xa8, 0x10, 0x00, 0x00, 0x00,
};
const MonoFont Scientifica5x11 = { Scientifica5x11Bitmap, nullptr, 95, 5, 11, 9 };
