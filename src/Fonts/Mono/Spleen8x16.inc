// Generated by Tools/generate_editor_fonts.mjs; ASCII subset, original glyph pixels.
// Copyright (c) 2018-2026, Frederic Cambus
// Source: https://raw.githubusercontent.com/fcambus/spleen/57f9219328c9f5873085320fe8bc8f7dd34b8791/spleen-8x16.bdf
// BDF SHA-256: b38b32a66920068965a3101f98071d310c5c74659fe86e55d346140770f8f6e8
// License: BSD-2-Clause; Fonts/licenses/Spleen-BSD-2-Clause.txt
static const uint8_t Spleen8x16Bitmap[] PROGMEM = {
  0x00, 0x00, 0x00, 0x00, 0x00, 0x00, 0x00, 0x00, 0x00, 0x00, 0x00, 0x00, 0x00, 0x00, 0x00, 0x00,
  0x00, 0x00, 0x18, 0x18, 0x18, 0x18, 0x18, 0x18, 0x18, 0x00, 0x18, 0x18, 0x00, 0x00, 0x00, 0x00,
  0x00, 0x66, 0x66, 0x66, 0x66, 0x00, 0x00, 0x00, 0x00, 0x00, 0x00, 0x00, 0x00, 0x00, 0x00, 0x00,
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  0x00, 0x00, 0x00, 0x00, 0x00, 0x00, 0x32, 0x7e, 0x4c, 0x00, 0x00, 0x00, 0x00, 0x00, 0x00, 0x00,
};
const MonoFont Spleen8x16 = { Spleen8x16Bitmap, nullptr, 95, 8, 16, 12 };
