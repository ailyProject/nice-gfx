// Generated by tools/generate_compact_sans.mjs.
// Derived from bundled GfxSansBoldCN24 bitmap (SHA256 aedc3c64a47b27ba91dd205c610acfe43c3a0f613381de5f3809aa02a66d45d9).
// Original Source Han Sans Copyright 2014-2025 Adobe; SIL OFL 1.1.
// Compact cell adaptation; Fonts/licenses/SourceHanSans-OFL-1.1.txt.
static const uint8_t GfxSansLatin24Bitmap[] PROGMEM = {
  0x00, 0x00, 0x00, 0x00, 0x00, 0x00, 0x00, 0x00, 0x00, 0x00, 0x00, 0x00, 0x00, 0x00, 0x00, 0x00, 0x00, 0x00, 0x00, 0x00, 0x00, 0x00, 0x00, 0x00,
  0x00, 0x00, 0x00, 0x00, 0x00, 0x00, 0x00, 0x00, 0x00, 0x00, 0x00, 0x00, 0x00, 0x00, 0x00, 0x00, 0x00, 0x00, 0x00, 0x00, 0x00, 0x00, 0x00, 0x00,
  0x00, 0x00, 0x00, 0x00, 0x00, 0x00, 0x00, 0x00, 0x00, 0x00, 0x00, 0x00, 0x00, 0x00, 0x00, 0x00, 0x00, 0x00, 0x00, 0x00, 0x00, 0x00, 0x00, 0x00,
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  0x00, 0x00, 0x00, 0x00, 0x00, 0x00, 0x00, 0x00,
};
const MonoFont GfxSansLatin24 = { GfxSansLatin24Bitmap, nullptr, 95, 15, 32, 24 };
