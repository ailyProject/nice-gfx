// Generated by Tools/generate_mono_fonts.py; do not edit.
// Source: profont12.bdf SHA256=af335a1bb14a7b0b049a9ada1f59bbbf0c0f5839ea467970d6090ac5280f5264
// License and copyright: Fonts/licenses/ and Fonts/README.md
// 95 glyphs, 6x12, 1140 bitmap bytes.
static const uint8_t proFontBitmap[] PROGMEM = {
  0x00, 0x00, 0x00, 0x00, 0x00, 0x00, 0x00, 0x00, 0x00, 0x00, 0x00, 0x00, 0x00, 0x00, 0x20, 0x20,
  0x20, 0x20, 0x20, 0x20, 0x00, 0x20, 0x00, 0x00, 0x00, 0x50, 0x50, 0x50, 0x00, 0x00, 0x00, 0x00,
  0x00, 0x00, 0x00, 0x00, 0x00, 0x00, 0x50, 0xF8, 0x50, 0xF8, 0x50, 0x00, 0x00, 0x00, 0x00, 0x00,
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  0x00, 0x00, 0x00, 0x00,
};
const MonoFont ProFont6x12 = { proFontBitmap, nullptr, 95, 6, 12, 10 };
