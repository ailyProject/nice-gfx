// Generated by tools/generate_compact_sans.mjs.
// Derived from bundled GfxSansCN16 bitmap (SHA256 1239dc8afc8035e18c94a7005048db5229777ddc8d71404620ec34aab92fdb94).
// Original Source Han Sans Copyright 2014-2025 Adobe; SIL OFL 1.1.
// Compact cell adaptation; Fonts/licenses/SourceHanSans-OFL-1.1.txt.
static const uint8_t GfxSansLatin16Bitmap[] PROGMEM = {
  0x00, 0x00, 0x00, 0x00, 0x00, 0x00, 0x00, 0x00, 0x00, 0x00, 0x00, 0x00, 0x00, 0x00, 0x00, 0x00, 0x00, 0x00, 0x00, 0x00, 0x00, 0x00, 0x00, 0x00,
  0x00, 0x00, 0x00, 0x00, 0x00, 0x00, 0x00, 0x00, 0x00, 0x00, 0x00, 0x00, 0x00, 0x00, 0x00, 0x00, 0x00, 0x00, 0x00, 0x00, 0x00, 0x00, 0x00, 0x00,
  0x00, 0x00, 0x08, 0x00, 0x08, 0x00, 0x08, 0x00, 0x08, 0x00, 0x08, 0x00, 0x08, 0x00, 0x08, 0x00, 0x08, 0x00, 0x00, 0x00, 0x00, 0x00, 0x0c, 0x00,
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  0x00, 0x00, 0x00, 0x00,
};
const MonoFont GfxSansLatin16 = { GfxSansLatin16Bitmap, nullptr, 95, 10, 22, 16 };
