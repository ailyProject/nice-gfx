// Generated by tools/generate_smooth_fonts.py; do not edit.
// Source: Source Han Sans CN 2.005R; SHA256=e2bc8a2e7f37474b774fff8db758681ece40bb6947a90d571bce9dd60671a8e4
// Rasterizer: {'Pillow': '12.3.0', 'FreeType': '2.14.3', 'fontTools': '4.64.0'}; em=24, baseline=24
// 4-bpp grayscale coverage; row-aligned, high nibble is the left pixel.
// Copyright 2014-2025 Adobe; SIL OFL 1.1.
// License: Fonts/licenses/SourceHanSans-OFL-1.1.txt and GfxSmoothLatin24-NOTICE.txt
// 95 glyphs, 15x32, 24320 bitmap bytes.
static const uint8_t gfxSmoothLatin24Bitmap[] PROGMEM = {
  0x00, 0x00, 0x00, 0x00, 0x00, 0x00, 0x00, 0x00, 0x00, 0x00, 0x00, 0x00, 0x00, 0x00, 0x00, 0x00,
  0x00, 0x00, 0x00, 0x00, 0x00, 0x00, 0x00, 0x00, 0x00, 0x00, 0x00, 0x00, 0x00, 0x00, 0x00, 0x00,
  0x00, 0x00, 0x00, 0x00, 0x00, 0x00, 0x00, 0x00, 0x00, 0x00, 0x00, 0x00, 0x00, 0x00, 0x00, 0x00,
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  0x00, 0x00, 0x00, 0x00, 0x00, 0x00, 0x00, 0x00, 0x00, 0x00, 0x00, 0x00, 0x00, 0x00, 0x00, 0x00,
};
const MonoFont GfxSmoothLatin24 = { gfxSmoothLatin24Bitmap, nullptr, 95, 15, 32, 24, nullptr, 4 };
