// Generated by Tools/generate_latin_fonts.py; do not edit.
// Source: Terminus 4.49.1 bold; renamed GfxTerm ASCII subset; SIL OFL 1.1
// Copyright (C) 2020 Dimitar Toshkov Zhekov
// BDF SHA256=92861fecd6f94c5ecc764fc43df5a69eb000ae13a75f652c6525db0495274f0a
// Font license: Fonts/licenses/Terminus-OFL-1.1.txt
// License and copyright: Fonts/licenses/ and Fonts/README.md
// 95 glyphs, 8x16, 1520 bitmap bytes.
static const uint8_t gfxTermBoldBitmap[] PROGMEM = {
  0x00, 0x00, 0x00, 0x00, 0x00, 0x00, 0x00, 0x00, 0x00, 0x00, 0x00, 0x00, 0x00, 0x00, 0x00, 0x00,
  0x00, 0x00, 0x18, 0x18, 0x18, 0x18, 0x18, 0x18, 0x18, 0x00, 0x18, 0x18, 0x00, 0x00, 0x00, 0x00,
  0x00, 0x66, 0x66, 0x66, 0x00, 0x00, 0x00, 0x00, 0x00, 0x00, 0x00, 0x00, 0x00, 0x00, 0x00, 0x00,
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  0x00, 0x73, 0xDB, 0xCE, 0x00, 0x00, 0x00, 0x00, 0x00, 0x00, 0x00, 0x00, 0x00, 0x00, 0x00, 0x00,
};
const MonoFont GfxTermBold8x16 = { gfxTermBoldBitmap, nullptr, 95, 8, 16, 12 };
