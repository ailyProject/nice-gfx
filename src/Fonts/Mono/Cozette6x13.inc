// Generated by Tools/generate_latin_fonts.py; do not edit.
// Source: Cozette v.1.30.0; ASCII subset; MIT; 4/q shifted left 1 px to retain all ink in 6 px cells
// Copyright (c) 2020-2025 Ines <ines@moonwit.ch>
// BDF SHA256=8d740166af3a14053773ac7a8846bf288c8818a44f73ab28d4725d91b03a5639
// Font license: Fonts/licenses/Cozette-MIT.txt
// License and copyright: Fonts/licenses/ and Fonts/README.md
// 95 glyphs, 6x13, 1235 bitmap bytes.
static const uint8_t cozetteBitmap[] PROGMEM = {
  0x00, 0x00, 0x00, 0x00, 0x00, 0x00, 0x00, 0x00, 0x00, 0x00, 0x00, 0x00, 0x00, 0x00, 0x00, 0x10,
  0x10, 0x10, 0x10, 0x10, 0x10, 0x00, 0x10, 0x00, 0x00, 0x00, 0x00, 0x28, 0x28, 0x28, 0x00, 0x00,
  0x00, 0x00, 0x00, 0x00, 0x00, 0x00, 0x00, 0x00, 0x00, 0x28, 0x28, 0x7C, 0x28, 0x28, 0x7C, 0x28,
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  0x00, 0x00, 0x00,
};
const MonoFont Cozette6x13 = { cozetteBitmap, nullptr, 95, 6, 13, 10 };
