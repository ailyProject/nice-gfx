// Generated by Tools/generate_editor_fonts.mjs; ASCII subset, original glyph pixels.
// Copyright 2010/2015 Scott Fial; Copyright 2011 Suraj N. Kurapati
// Source: https://raw.githubusercontent.com/sunaku/tamzen-font/3255e8259bc9b880c60ab8b737ec8aa574e00d75/bdf/Tamzen7x14r.bdf
// BDF SHA-256: 57b1365606b7b5995a3aff644f673b8c1a1aa9ea184afe5771ce6e79ab4083f0
// License: Tamzen/Tamsyn permissive license; Fonts/licenses/Tamzen.txt
static const uint8_t Tamzen7x14Bitmap[] PROGMEM = {
  0x00, 0x00, 0x00, 0x00, 0x00, 0x00, 0x00, 0x00, 0x00, 0x00, 0x00, 0x00, 0x00, 0x00, 0x00, 0x00,
  0x10, 0x10, 0x10, 0x10, 0x10, 0x00, 0x00, 0x10, 0x10, 0x00, 0x00, 0x00, 0x00, 0x00, 0x28, 0x28,
  0x28, 0x28, 0x00, 0x00, 0x00, 0x00, 0x00, 0x00, 0x00, 0x00, 0x00, 0x00, 0x00, 0x28, 0x28, 0x7c,
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  0x00, 0x00,
};
const MonoFont Tamzen7x14 = { Tamzen7x14Bitmap, nullptr, 95, 7, 14, 11 };
