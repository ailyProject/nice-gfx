// Generated by Tools/generate_editor_fonts.mjs; ASCII subset, original glyph pixels.
// Copyright 2010/2015 Scott Fial; Copyright 2011 Suraj N. Kurapati
// Source: https://raw.githubusercontent.com/sunaku/tamzen-font/3255e8259bc9b880c60ab8b737ec8aa574e00d75/bdf/Tamzen8x16b.bdf
// BDF SHA-256: d7eeee82426cfbdf82aa8f631363c8db495289c24b17c3c03167c3e6dfce3656
// License: Tamzen/Tamsyn permissive license; Fonts/licenses/Tamzen.txt
static const uint8_t TamzenBold8x16Bitmap[] PROGMEM = {
  0x00, 0x00, 0x00, 0x00, 0x00, 0x00, 0x00, 0x00, 0x00, 0x00, 0x00, 0x00, 0x00, 0x00, 0x00, 0x00,
  0x00, 0x00, 0x18, 0x3c, 0x3c, 0x3c, 0x18, 0x18, 0x00, 0x00, 0x18, 0x18, 0x00, 0x00, 0x00, 0x00,
  0x00, 0x6c, 0x6c, 0x6c, 0x6c, 0x00, 0x00, 0x00, 0x00, 0x00, 0x00, 0x00, 0x00, 0x00, 0x00, 0x00,
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  0x00, 0x00, 0x33, 0x7b, 0x6f, 0x66, 0x00, 0x00, 0x00, 0x00, 0x00, 0x00, 0x00, 0x00, 0x00, 0x00,
};
const MonoFont TamzenBold8x16 = { TamzenBold8x16Bitmap, nullptr, 95, 8, 16, 12 };
