// Generated by Tools/generate_editor_fonts.mjs; ASCII subset, original glyph pixels.
// Copyright (c) 2018-2026, Frederic Cambus
// Source: https://raw.githubusercontent.com/fcambus/spleen/57f9219328c9f5873085320fe8bc8f7dd34b8791/spleen-12x24.bdf
// BDF SHA-256: ab7f434db312de6700e55ee7f174ebd0bd57fef16f7a15bc9ac9478fb26f2cd1
// License: BSD-2-Clause; Fonts/licenses/Spleen-BSD-2-Clause.txt
static const uint8_t Spleen12x24Bitmap[] PROGMEM = {
  0x00, 0x00, 0x00, 0x00, 0x00, 0x00, 0x00, 0x00, 0x00, 0x00, 0x00, 0x00, 0x00, 0x00, 0x00, 0x00,
  0x00, 0x00, 0x00, 0x00, 0x00, 0x00, 0x00, 0x00, 0x00, 0x00, 0x00, 0x00, 0x00, 0x00, 0x00, 0x00,
  0x00, 0x00, 0x00, 0x00, 0x00, 0x00, 0x00, 0x00, 0x00, 0x00, 0x00, 0x00, 0x00, 0x00, 0x00, 0x00,
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  0x00, 0x00, 0x00, 0x00, 0x00, 0x00, 0x00, 0x00, 0x00, 0x00, 0x00, 0x00, 0x00, 0x00, 0x00, 0x00,
};
const MonoFont Spleen12x24 = { Spleen12x24Bitmap, nullptr, 95, 12, 24, 19 };
