// Generated by Tools/generate_latin_fonts.py; do not edit.
// Source: Terminus 4.49.1 normal; renamed GfxTerm ASCII subset; SIL OFL 1.1
// Copyright (C) 2020 Dimitar Toshkov Zhekov
// BDF SHA256=5197662b22bf9f3e68d4af9f969a7fefa3edae40dd82ae969a147381130fb4ae
// Font license: Fonts/licenses/Terminus-OFL-1.1.txt
// License and copyright: Fonts/licenses/ and Fonts/README.md
// 95 glyphs, 8x16, 1520 bitmap bytes.
static const uint8_t gfxTermBitmap[] PROGMEM = {
  0x00, 0x00, 0x00, 0x00, 0x00, 0x00, 0x00, 0x00, 0x00, 0x00, 0x00, 0x00, 0x00, 0x00, 0x00, 0x00,
  0x00, 0x00, 0x10, 0x10, 0x10, 0x10, 0x10, 0x10, 0x10, 0x00, 0x10, 0x10, 0x00, 0x00, 0x00, 0x00,
  0x00, 0x24, 0x24, 0x24, 0x00, 0x00, 0x00, 0x00, 0x00, 0x00, 0x00, 0x00, 0x00, 0x00, 0x00, 0x00,
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  0x00, 0x62, 0x92, 0x8C, 0x00, 0x00, 0x00, 0x00, 0x00, 0x00, 0x00, 0x00, 0x00, 0x00, 0x00, 0x00,
};
const MonoFont GfxTerm8x16 = { gfxTermBitmap, nullptr, 95, 8, 16, 12 };
