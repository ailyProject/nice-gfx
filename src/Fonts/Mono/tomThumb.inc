// Generated by Tools/generate_mono_fonts.py; do not edit.
// Source: tom-thumb.bdf SHA256=d2c8c15de5ca83fcaef7cadc06d8db578c082507fa3da8a8f698d026fdda2b14
// License and copyright: Fonts/licenses/ and Fonts/README.md
// 95 glyphs, 4x6, 570 bitmap bytes.
static const uint8_t tomThumbBitmap[] PROGMEM = {
  0x00, 0x00, 0x00, 0x00, 0x00, 0x00, 0x40, 0x40, 0x40, 0x00, 0x40, 0x00, 0xA0, 0xA0, 0x00, 0x00,
  0x00, 0x00, 0xA0, 0xE0, 0xA0, 0xE0, 0xA0, 0x00, 0x60, 0xC0, 0x60, 0xC0, 0x40, 0x00, 0x80, 0x20,
  0x40, 0x80, 0x20, 0x00, 0xC0, 0xC0, 0xE0, 0xA0, 0x60, 0x00, 0x40, 0x40, 0x00, 0x00, 0x00, 0x00,
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  0x20, 0x40, 0xC0, 0x00, 0x60, 0xC0, 0x00, 0x00, 0x00, 0x00,
};
const MonoFont TomThumb4x6 = { tomThumbBitmap, nullptr, 95, 4, 6, 5 };
